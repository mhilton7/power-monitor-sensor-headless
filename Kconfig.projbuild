## Kconfig.projbuild
```kconfig
menu "PowerMeter V2 headless sensor"

choice PM_METER_VARIANT
    prompt "PZEM protocol variant"
    default PM_METER_VARIANT_UNSPECIFIED
    help
        Select only after matching physical markings and protocol evidence.
        Production builds reject an unspecified variant.

    config PM_METER_VARIANT_UNSPECIFIED
        bool "Unspecified (safe; physical meter disabled)"

    config PM_METER_VARIANT_PZEM004T_V4_CLASSIC
        bool "PZEM-004T V4-classic candidate (0x04/10 input registers)"
endchoice

config PM_HARDWARE_IDENTITY_VERIFIED
    bool "Marked PZEM unit identity has passed the physical verification gate"
    default n
    depends on PM_METER_VARIANT_PZEM004T_V4_CLASSIC
    help
        Enable only for a build tied to machine-readable evidence from the
        exact marked PZEM and ESP32-S3 unit. A generic seller listing is not
        sufficient evidence.

config PM_PRODUCTION_RELEASE
    bool "Stable production release build"
    default n
    help
        Requires both a selected meter variant and verified hardware evidence.

config PM_RELEASE_CANDIDATE
    bool "Hardware-pending release-candidate build"
    default n
    help
        Builds all production paths but keeps physical meter acquisition
        fail-closed until local identity verification is committed.

config PM_SIMULATED_METER
    bool "Use deterministic simulated meter"
    default n
    help
        Test-only profile. Simulated readings are explicitly marked and are
        rejected by production server ingestion.

config PM_HEARTBEAT_SECONDS
    int "Heartbeat period in seconds"
    range 5 300
    default 15

config PM_METER_SAMPLE_MS
    int "PZEM sampling interval in milliseconds"
    range 250 60000
    default 1000

config PM_DURABLE_INTERVAL_SECONDS
    int "Durable interval duration in seconds"
    range 10 3600
    default 60

config PM_SD_SPI_KHZ
    int "Initial microSD SPI frequency in kHz"
    range 400 20000
    default 4000

endmenu
```

## main/Kconfig.projbuild
```kconfig
menu "PowerMeter V2 headless sensor"

choice PM_METER_VARIANT
    prompt "PZEM protocol variant"
    default PM_METER_VARIANT_UNSPECIFIED
    help
        Select only after matching physical markings and protocol evidence.
        Production builds reject an unspecified variant.

    config PM_METER_VARIANT_UNSPECIFIED
        bool "Unspecified (safe; physical meter disabled)"

    config PM_METER_VARIANT_PZEM004T_V4_CLASSIC
        bool "PZEM-004T V4-classic candidate (0x04/10 input registers)"
endchoice

config PM_HARDWARE_IDENTITY_VERIFIED
    bool "Marked PZEM unit identity has passed the physical verification gate"
    default n
    help
        Enable only for a build tied to machine-readable evidence from the
        exact marked PZEM and ESP32-S3 unit. A generic seller listing is not
        sufficient evidence.

config PM_PRODUCTION_RELEASE
    bool "Stable production release build"
    default n

config PM_RELEASE_CANDIDATE
    bool "Hardware-pending release-candidate build"
    default n

config PM_SIMULATED_METER
    bool "Use deterministic simulated meter"
    default n

config PM_PZEM_LIVE_VALIDATION
    bool "Poll the selected PZEM candidate in a non-production validation build"
    default n
    depends on PM_RELEASE_CANDIDATE
    depends on PM_METER_VARIANT_PZEM004T_V4_CLASSIC
    depends on !PM_HARDWARE_IDENTITY_VERIFIED
    depends on !PM_PRODUCTION_RELEASE
    depends on !PM_SIMULATED_METER
    help
        Enables real UART reads from the explicitly selected PZEM candidate
        while physical certification remains pending. This is for collecting
        marked-unit validation evidence and must never satisfy the stable
        production hardware-identity gate.

config PM_TELEMETRY_INTERVAL_SECONDS
    int "Stateless telemetry interval in seconds"
    range 2 60
    default 5
    help
        The sensor samples continuously but sends only the newest RAM sample
        at this cadence. The server may return another bounded value at runtime.

config PM_METER_SAMPLE_MS
    int "PZEM sampling interval in milliseconds"
    range 250 60000
    default 1000

endmenu
```

## sdkconfig.defaults
```kconfig
CONFIG_IDF_TARGET="esp32s3"
CONFIG_ESPTOOLPY_FLASHSIZE_16MB=y
CONFIG_ESPTOOLPY_FLASHMODE_DIO=y
CONFIG_ESPTOOLPY_FLASHFREQ_80M=y
CONFIG_PARTITION_TABLE_CUSTOM=y
CONFIG_PARTITION_TABLE_CUSTOM_FILENAME="partitions.csv"
CONFIG_PARTITION_TABLE_OFFSET=0x8000
CONFIG_SPIRAM=y
CONFIG_SPIRAM_MODE_OCT=y
CONFIG_SPIRAM_TYPE_AUTO=y
CONFIG_SPIRAM_SPEED_80M=y
CONFIG_SPIRAM_MALLOC_ALWAYSINTERNAL=16384
CONFIG_SPIRAM_MALLOC_RESERVE_INTERNAL=65536
CONFIG_ESP_CONSOLE_USB_SERIAL_JTAG=y
CONFIG_BOOTLOADER_APP_ROLLBACK_ENABLE=y
CONFIG_ESP_COREDUMP_ENABLE_TO_FLASH=y
CONFIG_ESP_TASK_WDT_EN=y
CONFIG_ESP_TASK_WDT_INIT=y
CONFIG_ESP_TASK_WDT_TIMEOUT_S=10
CONFIG_ESP_MAIN_TASK_STACK_SIZE=8192
CONFIG_COMPILER_WARN_WRITE_STRINGS=y
CONFIG_COMPILER_OPTIMIZATION_SIZE=y
CONFIG_MBEDTLS_SSL_PROTO_TLS1_2=y
CONFIG_MBEDTLS_CERTIFICATE_BUNDLE=n
CONFIG_PM_METER_VARIANT_UNSPECIFIED=y
CONFIG_PM_HARDWARE_IDENTITY_VERIFIED=n
CONFIG_PM_PRODUCTION_RELEASE=n
CONFIG_PM_RELEASE_CANDIDATE=n
CONFIG_PM_SIMULATED_METER=n
CONFIG_PM_PZEM_LIVE_VALIDATION=n
CONFIG_PM_METER_SAMPLE_MS=1000
CONFIG_PM_TELEMETRY_INTERVAL_SECONDS=5
```
